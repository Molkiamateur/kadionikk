## tp-yocto/meta-training-ext/conf/layer.conf
```bitbake
# We have a conf and classes directory, add to BBPATH
BBPATH .= ":${LAYERDIR}"

# We have recipes-* directories, add to BBFILES
BBFILES += "${LAYERDIR}/recipes-*/*/*.bb \
            ${LAYERDIR}/recipes-*/*/*.bbappend"

BBFILE_COLLECTIONS += "meta-training-ext"
BBFILE_PATTERN_meta-training-ext = "^${LAYERDIR}/"
BBFILE_PRIORITY_meta-training-ext = "6"

LAYERDEPENDS_meta-training-ext = "core"
LAYERSERIES_COMPAT_meta-training-ext = "scarthgap"
```
